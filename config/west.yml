## config/west.yml
```yaml
manifest:
  remotes:
    - name: zmkfirmware
      url-base: https://github.com/zmkfirmware
    - name: badjeff
      url-base: https://github.com/badjeff
    - name: hsgw
      url-base: https://github.com/hsgw
    - name: pite1222
      url-base: https://github.com/pite1222

  projects:
    - name: zmk
      remote: pite1222
      revision: release/conductor-0.5.4
      import: app/west.yml

    - name: zmk-studio-messages
      remote: pite1222
      revision: release/conductor-0.5.1
      path: modules/msgs/zmk-studio-messages

    - name: zmk-pmw3610-driver
      remote: badjeff
      revision: main
    
    - name: zmk-feature-sensor_rotation
      remote: hsgw
      revision: main
      
  self:
    path: config
```
